## ESP32_Client/src/Kconfig.projbuild
```kconfig
menu "(FSE-CFG) WIFI Configuration"

    config ESP_WIFI_SSID
        string "WiFi SSID"
        default "myssid"
        help
            SSID (network name).

    config ESP_WIFI_PASSWORD
        string "WiFi Password"
        default "mypassword"
        help
            WiFi password (WPA or WPA2).
    
    choice ESP_WIFI_SCAN_AUTH_MODE_THRESHOLD
        prompt "WiFi Scan auth mode threshold"
        default ESP_WIFI_AUTH_OPEN
        help
            The weakest authmode to accept in the scan mode.

        config ESP_WIFI_AUTH_OPEN
            bool "OPEN"
        config ESP_WIFI_AUTH_WEP
            bool "WEP"
        config ESP_WIFI_AUTH_WPA_PSK
            bool "WPA PSK"
        config ESP_WIFI_AUTH_WPA2_PSK
            bool "WPA2 PSK"
        config ESP_WIFI_AUTH_WPA_WPA2_PSK
            bool "WPA/WPA2 PSK"
        config ESP_WIFI_AUTH_WPA3_PSK
            bool "WPA3 PSK"
        config ESP_WIFI_AUTH_WPA2_WPA3_PSK
            bool "WPA2/WPA3 PSK"
        config ESP_WIFI_AUTH_WAPI_PSK
            bool "WAPI PSK"
    endchoice

endmenu

menu "(FSE-CFG) Modo de Energia"
 
    choice ESP_ENERGY_MODE
        prompt "Modo de consumo de energia da placa."
        default NORMAL_MODE
        help
          Defines ESP energy consumption mode.
             
        config LOW_POWER_MODE
            int "Modo bateria [1 - Ligado e 0 - Desligado]"
            default 0
    endchoice

endmenu

menu "(FSE-CFG) Basic ESP Config"

    config ESP_ROOT_TOPIC
        string "Root topic"
        default "fse2021"
        help
            Tópico root.
    
    config ESP_MATRICULA
        string "Matrícula"
        default "180106970"
        help
            Matrícula.

endmenu
```
